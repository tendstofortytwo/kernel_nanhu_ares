## arch/arm/configs/msm7627a-perf_defconfig
```kconfig
# CONFIG_ARM_PATCH_PHYS_VIRT is not set
CONFIG_EXPERIMENTAL=y
CONFIG_LOCALVERSION="$(KERNEL_LOCAL_VERSION)-perf"
# CONFIG_SWAP is not set
CONFIG_SYSVIPC=y
CONFIG_IKCONFIG=y
CONFIG_IKCONFIG_PROC=y
CONFIG_CGROUPS=y
CONFIG_CGROUP_FREEZER=y
CONFIG_CGROUP_DEVICE=y
CONFIG_CGROUP_CPUACCT=y
CONFIG_RESOURCE_COUNTERS=y
CONFIG_CGROUP_SCHED=y
CONFIG_RT_GROUP_SCHED=y
CONFIG_BLK_DEV_INITRD=y
CONFIG_CC_OPTIMIZE_FOR_SIZE=y
CONFIG_KALLSYMS_ALL=y
CONFIG_ASHMEM=y
CONFIG_EMBEDDED=y
CONFIG_PROFILING=y
CONFIG_OPROFILE=y
CONFIG_KPROBES=y
CONFIG_MODULES=y
CONFIG_MODULE_UNLOAD=y
CONFIG_MODVERSIONS=y
# CONFIG_BLK_DEV_BSG is not set
CONFIG_PARTITION_ADVANCED=y
# CONFIG_IOSCHED_DEADLINE is not set
CONFIG_ARCH_MSM=y
CONFIG_ARCH_MSM7X27=y
CONFIG_ARCH_MSM8625=y
CONFIG_MSM_SOC_REV_A=y
# CONFIG_MACH_MSM7X27_SURF is not set
# CONFIG_MACH_MSM7X27_FFA is not set
# CONFIG_MSM_STACKED_MEMORY is not set
CONFIG_MSM7X00A_USE_DG_TIMER=y
# CONFIG_MSM_FIQ_SUPPORT is not set
CONFIG_MSM_SMD=y
CONFIG_MSM_SMD_PKG4=y
# CONFIG_MSM_SMD_DEBUG is not set
# CONFIG_MSM_RESET_MODEM is not set
# CONFIG_MSM_SMD_NMEA is not set
# CONFIG_MSM_SMD_QMI is not set
CONFIG_MSM_ONCRPCROUTER=y
# CONFIG_MSM_RPCSERVER_TIME_REMOTE is not set
CONFIG_MSM_RMT_STORAGE_CLIENT=y
# CONFIG_MSM_HW3D is not set
CONFIG_MSM7X27A_AUDIO=y
CONFIG_MSM_DMA_TEST=y
CONFIG_MSM_SLEEP_STATS_DEVICE=y
CONFIG_BT_MSM_PINTEST=y
CONFIG_MSM_RPC_VIBRATOR=y
CONFIG_PM8XXX_RPC_VIBRATOR=y
CONFIG_MSM_SPM_V2=y
CONFIG_MSM_MULTIMEDIA_USE_ION=y
CONFIG_MSM_CPR=y
CONFIG_MSM_VP_REGULATOR=y
CONFIG_ARM_THUMBEE=y
CONFIG_NO_HZ=y
CONFIG_HIGH_RES_TIMERS=y
CONFIG_SMP=y
CONFIG_PREEMPT=y
CONFIG_AEABI=y
#2013/1/9, Arima StevenShi, for performance begin.
#CONFIG_HIGHMEM=y
#2013/1/9, Arima StevenShi, for performance end.
CONFIG_VMALLOC_RESERVE=0xC800000
CONFIG_COMPACTION=y
CONFIG_CP_ACCESS=y
CONFIG_ZBOOT_ROM_TEXT=0x0
CONFIG_ZBOOT_ROM_BSS=0x0
CONFIG_CMDLINE="init=/sbin/init root=/dev/ram rw initrd=0x11000000,16M console=ttyDCC0 mem=88M"
CONFIG_CPU_FREQ=y
CONFIG_CPU_FREQ_STAT_DETAILS=y
CONFIG_CPU_FREQ_GOV_POWERSAVE=y
CONFIG_CPU_FREQ_GOV_USERSPACE=y
CONFIG_CPU_FREQ_GOV_ONDEMAND=y
CONFIG_CPU_FREQ_GOV_INTERACTIVE=y
CONFIG_CPU_FREQ_GOV_CONSERVATIVE=y
CONFIG_VFP=y
CONFIG_NEON=y
# CONFIG_CORE_DUMP_DEFAULT_ELF_HEADERS is not set
CONFIG_WAKELOCK=y
CONFIG_PM_RUNTIME=y
CONFIG_NET=y
CONFIG_PACKET=y
CONFIG_UNIX=y
CONFIG_INET=y
CONFIG_IP_ADVANCED_ROUTER=y
CONFIG_IP_MULTIPLE_TABLES=y
CONFIG_IPV6=y
CONFIG_IPV6_PRIVACY=y
CONFIG_IPV6_ROUTER_PREF=y
CONFIG_IPV6_ROUTE_INFO=y
CONFIG_IPV6_OPTIMISTIC_DAD=y
CONFIG_INET6_AH=y
CONFIG_INET6_ESP=y
CONFIG_INET6_IPCOMP=y
CONFIG_IPV6_MIP6=y
CONFIG_IPV6_TUNNEL=y
CONFIG_IPV6_MULTIPLE_TABLES=y
CONFIG_IPV6_SUBTREES=y
CONFIG_NETFILTER=y
CONFIG_NETFILTER_NETLINK_LOG=y
CONFIG_NF_CONNTRACK=y
CONFIG_NF_CONNTRACK_EVENTS=y
CONFIG_NF_CT_PROTO_DCCP=y
CONFIG_NF_CT_PROTO_SCTP=y
CONFIG_NF_CT_PROTO_UDPLITE=y
CONFIG_NF_CONNTRACK_AMANDA=y
CONFIG_NF_CONNTRACK_FTP=y
CONFIG_NF_CONNTRACK_H323=y
CONFIG_NF_CONNTRACK_IRC=y
CONFIG_NF_CONNTRACK_NETBIOS_NS=y
CONFIG_NF_CONNTRACK_PPTP=y
CONFIG_NF_CONNTRACK_SANE=y
CONFIG_NF_CONNTRACK_SIP=y
CONFIG_NF_CONNTRACK_TFTP=y
CONFIG_NF_CT_NETLINK=y
CONFIG_NETFILTER_TPROXY=y
CONFIG_NETFILTER_XT_TARGET_CLASSIFY=y
CONFIG_NETFILTER_XT_TARGET_CONNMARK=y
CONFIG_NETFILTER_XT_TARGET_LOG=y
CONFIG_NETFILTER_XT_TARGET_MARK=y
CONFIG_NETFILTER_XT_TARGET_NFQUEUE=y
CONFIG_NETFILTER_XT_MATCH_COMMENT=y
CONFIG_NETFILTER_XT_MATCH_CONNLIMIT=y
CONFIG_NETFILTER_XT_MATCH_CONNMARK=y
CONFIG_NETFILTER_XT_MATCH_CONNTRACK=y
CONFIG_NETFILTER_XT_MATCH_HASHLIMIT=y
CONFIG_NETFILTER_XT_MATCH_HELPER=y
CONFIG_NETFILTER_XT_MATCH_IPRANGE=y
CONFIG_NETFILTER_XT_MATCH_LENGTH=y
CONFIG_NETFILTER_XT_MATCH_LIMIT=y
CONFIG_NETFILTER_XT_MATCH_MAC=y
CONFIG_NETFILTER_XT_MATCH_MARK=y
CONFIG_NETFILTER_XT_MATCH_POLICY=y
CONFIG_NETFILTER_XT_MATCH_PKTTYPE=y
CONFIG_NETFILTER_XT_MATCH_QTAGUID=y
CONFIG_NETFILTER_XT_MATCH_QUOTA=y
CONFIG_NETFILTER_XT_MATCH_QUOTA2=y
CONFIG_NETFILTER_XT_MATCH_QUOTA2_LOG=y
CONFIG_NETFILTER_XT_MATCH_SOCKET=y
CONFIG_NETFILTER_XT_MATCH_STATE=y
CONFIG_NETFILTER_XT_MATCH_STATISTIC=y
CONFIG_NETFILTER_XT_MATCH_STRING=y
CONFIG_NETFILTER_XT_MATCH_TIME=y
CONFIG_NETFILTER_XT_MATCH_U32=y
CONFIG_NF_CONNTRACK_IPV4=y
CONFIG_IP_NF_IPTABLES=y
CONFIG_IP_NF_MATCH_AH=y
CONFIG_IP_NF_MATCH_ECN=y
CONFIG_IP_NF_MATCH_TTL=y
CONFIG_IP_NF_FILTER=y
CONFIG_IP_NF_TARGET_REJECT=y
CONFIG_NF_NAT=y
CONFIG_IP_NF_TARGET_MASQUERADE=y
CONFIG_IP_NF_TARGET_NETMAP=y
CONFIG_IP_NF_TARGET_REDIRECT=y
CONFIG_IP_NF_MANGLE=y
CONFIG_IP_NF_ARPTABLES=y
CONFIG_IP_NF_ARPFILTER=y
CONFIG_IP_NF_ARP_MANGLE=y
CONFIG_IP6_NF_IPTABLES=y
#20120904-JordanChen , [ATS00151794] Enable ip6tables utility
CONFIG_IP6_NF_FILTER=y                                                                                                                                   
CONFIG_IP6_NF_MANGLE=y
#CONFIG_IP6_NF_MATCH_RPFILTER=y
#CONFIG_NF_CONNTRACK_IPV6=y
#CONFIG_IP6_NF_QUEUE=y
#CONFIG_IP6_NF_MATCH_AH=y
#CONFIG_IP6_NF_MATCH_EUI64=y
#CONFIG_IP6_NF_MATCH_FRAG=y
#CONFIG_IP6_NF_MATCH_OPTS=y
#CONFIG_IP6_NF_MATCH_HL=y
#CONFIG_IP6_NF_MATCH_IPV6HEADER=y
#CONFIG_IP6_NF_MATCH_MH=y
#CONFIG_IP6_NF_MATCH_RT=y
#CONFIG_IP6_NF_TARGET_HL=y
#20121023, SoMC w43.2 patch begin
CONFIG_IP6_NF_TARGET_REJECT=y
#20121023, SoMC w43.2 patch end
#CONFIG_IP6_NF_RAW=y
##
CONFIG_BT=y
CONFIG_BT_RFCOMM=y
CONFIG_BT_RFCOMM_TTY=y
CONFIG_BT_BNEP=y
CONFIG_BT_BNEP_MC_FILTER=y
CONFIG_BT_BNEP_PROTO_FILTER=y
CONFIG_BT_HIDP=y
CONFIG_BT_HCIUART=y
CONFIG_BT_HCIUART_H4=y
CONFIG_BT_HCIUART_IBS=y
CONFIG_MSM_BT_POWER=y
CONFIG_CFG80211=m
# CONFIG_CFG80211_WEXT is not set
CONFIG_RFKILL=y
CONFIG_GENLOCK=y
CONFIG_GENLOCK_MISCDEVICE=y
CONFIG_MTD=y
CONFIG_MTD_TESTS=m
CONFIG_MTD_CMDLINE_PARTS=y
CONFIG_MTD_CHAR=y
CONFIG_MTD_BLOCK=y
CONFIG_BLK_DEV_LOOP=y
CONFIG_SCSI=y
CONFIG_SCSI_TGT=y
CONFIG_BLK_DEV_SD=y
CONFIG_CHR_DEV_SG=y
CONFIG_CHR_DEV_SCH=y
CONFIG_SCSI_MULTI_LUN=y
CONFIG_SCSI_CONSTANTS=y
CONFIG_SCSI_LOGGING=y
CONFIG_SCSI_SCAN_ASYNC=y
CONFIG_MD=y
CONFIG_BLK_DEV_DM=y
CONFIG_DM_CRYPT=y
CONFIG_NETDEVICES=y
CONFIG_TUN=y
CONFIG_SMC91X=y
CONFIG_SMSC911X=y
CONFIG_LIBRA_SDIOIF=m
# CONFIG_INPUT_MOUSEDEV is not set
CONFIG_INPUT_EVDEV=y
CONFIG_INPUT_EVBUG=m
# /*++ Huize - 20121009 Modify for using ++*/
CONFIG_INPUT_KEYBOARD=y
# /*-- Huize - 20121009 Modify for using --*/
# CONFIG_INPUT_MOUSE is not set
CONFIG_INPUT_TOUCHSCREEN=y
# /*++ Huize - 20121008 Remove for non-using ++*/
# CONFIG_TOUCHSCREEN_ATMEL_MAXTOUCH is not set
# CONFIG_TOUCHSCREEN_ATMEL_MXT is not set
# CONFIG_TOUCHSCREEN_SYNAPTICS_RMI4_I2C is not set
# CONFIG_TOUCHSCREEN_FT5X06 is not set
# /*-- Huize - 20121008 Remove for non-using --*/
CONFIG_INPUT_MISC=y
CONFIG_INPUT_UINPUT=y
CONFIG_INPUT_GPIO=y
# CONFIG_SERIO is not set
# CONFIG_LEGACY_PTYS is not set
CONFIG_SERIAL_MSM=y
CONFIG_SERIAL_MSM_CONSOLE=y
CONFIG_SERIAL_MSM_HS=y
# CONFIG_SERIAL_MSM_CLOCK_CONTROL is not set
CONFIG_DIAG_CHAR=y
# CONFIG_HW_RANDOM is not set
CONFIG_I2C=y
CONFIG_I2C_CHARDEV=y
# CONFIG_I2C_MSM is not set
CONFIG_I2C_QUP=y
CONFIG_DEBUG_GPIO=y
CONFIG_GPIO_SYSFS=y
## 20120723-JordanChen , Removed default non-used device
# CONFIG_GPIO_SX150X is not set
##
CONFIG_POWER_SUPPLY=y
CONFIG_BATTERY_MSM=y
## 20120723-JordanChen , HWMON (Hardware monitor) for sensors (fans sensor,temp. sensor....) , new module since 1040 baseline
# removed for temporary
# CONFIG_HWMON is not set
## 20120723-JordanChen , Dependence with HWMON
# removed for temporary
# CONFIG_SENSORS_MSM_ADC is not set
#
CONFIG_MARIMBA_CORE=y
CONFIG_REGULATOR_MSM_GPIO=y
CONFIG_MEDIA_SUPPORT=y
CONFIG_MEDIA_CONTROLLER=y
CONFIG_VIDEO_DEV=y
CONFIG_VIDEO_V4L2_SUBDEV_API=y
# CONFIG_RC_CORE is not set
# CONFIG_MEDIA_TUNER_CUSTOMISE is not set
CONFIG_VIDEOBUF2_MSM_MEM=y
CONFIG_V4L_PLATFORM_DRIVERS=y
CONFIG_MSM_CAMERA_V4L2=y
# /*++ Huize - 20121009 Modify for unused ++*/
# CONFIG_OV5647 is not set
# CONFIG_AD5046_ACT is not set
# CONFIG_WEBCAM_OV9726 is not set
# CONFIG_MT9E013 is not set
# CONFIG_S5K4E1 is not set
# CONFIG_DW9712_ACT is not set
CONFIG_MSM_CAMERA_FLASH_SC628A=y
# CONFIG_OV8825 is not set
CONFIG_MSM_CAMERA_SENSOR=y
CONFIG_MSM_ACTUATOR=y
# CONFIG_OV7692 is not set
# /*-- Huize - 20121009 Modify for unused --*/
CONFIG_RADIO_TAVARUA=y
CONFIG_ION=y
CONFIG_ION_MSM=y
CONFIG_MSM_KGSL=y
CONFIG_MSM_KGSL_DISABLE_SHADOW_WRITES=y
CONFIG_FB=y
CONFIG_FB_MSM=y
# CONFIG_FB_MSM_BACKLIGHT is not set
CONFIG_FB_MSM_TRIPLE_BUFFER=y
CONFIG_FB_MSM_MDP30=y
CONFIG_FB_MSM_MDP303=y
## 20120723-JordanChen , New panel device from Qualcomm
# CONFIG_FB_MSM_LCDC_TRULY_HVGA_IPS3P2335_PT_PANEL is not set
##
# CONFIG_FB_MSM_MIPI_PANEL_DETECT is not set
CONFIG_BACKLIGHT_LCD_SUPPORT=y
CONFIG_BACKLIGHT_CLASS_DEVICE=y
CONFIG_SOUND=y
CONFIG_SND=y
CONFIG_SND_SOC=y
CONFIG_SND_MSM_SOC=y
CONFIG_HID_APPLE=y
CONFIG_HID_MAGICMOUSE=y
CONFIG_HID_MICROSOFT=y
CONFIG_USB=y
CONFIG_USB_ANNOUNCE_NEW_DEVICES=y
CONFIG_USB_SUSPEND=y
CONFIG_USB_EHCI_HCD=y
CONFIG_USB_EHCI_EHSET=y
CONFIG_USB_EHCI_ROOT_HUB_TT=y
# CONFIG_USB_EHCI_TT_NEWSCHED is not set
CONFIG_USB_EHCI_MSM_72K=y
CONFIG_USB_ACM=y
CONFIG_USB_STORAGE=y
CONFIG_USB_STORAGE_DATAFAB=y
CONFIG_USB_STORAGE_FREECOM=y
CONFIG_USB_STORAGE_ISD200=y
CONFIG_USB_STORAGE_USBAT=y
CONFIG_USB_STORAGE_SDDR09=y
CONFIG_USB_STORAGE_SDDR55=y
CONFIG_USB_STORAGE_JUMPSHOT=y
CONFIG_USB_STORAGE_ALAUDA=y
CONFIG_USB_STORAGE_ONETOUCH=y
CONFIG_USB_STORAGE_KARMA=y
CONFIG_USB_STORAGE_CYPRESS_ATACB=y
CONFIG_USB_EHSET_TEST_FIXTURE=y
CONFIG_USB_GADGET=y
CONFIG_USB_MSM_72K=y
CONFIG_USB_G_ANDROID=y
CONFIG_RMNET_SMD_CTL_CHANNEL="DATA40_CNTL"
CONFIG_RMNET_SMD_DATA_CHANNEL="DATA40"
CONFIG_MMC=y
CONFIG_MMC_PERF_PROFILING=y
CONFIG_MMC_UNSAFE_RESUME=y
CONFIG_MMC_CLKGATE=y
CONFIG_MMC_PARANOID_SD_INIT=y
CONFIG_MMC_BLOCK_MINORS=32
# CONFIG_MMC_BLOCK_BOUNCE is not set
CONFIG_MMC_TEST=m
CONFIG_MMC_MSM=y
CONFIG_MMC_MSM_SDC3_SUPPORT=y
CONFIG_MMC_MSM_SDC3_8_BIT_SUPPORT=y
# /*++ Huize - 20121008 Remove for unused ++*/
# CONFIG_LEDS_GPIO is not set
# /*-- Huize - 20121008 Remove for unused --*/
CONFIG_LEDS_MSM_PDM=y
CONFIG_LEDS_PMIC_MPP=y
CONFIG_LEDS_MSM_TRICOLOR=y
CONFIG_SWITCH=y
CONFIG_SWITCH_GPIO=y
CONFIG_RTC_CLASS=y
CONFIG_STAGING=y
CONFIG_ANDROID=y
CONFIG_ANDROID_BINDER_IPC=y
CONFIG_ANDROID_LOGGER=y
CONFIG_ANDROID_LOW_MEMORY_KILLER=y
CONFIG_EXT2_FS=y
CONFIG_EXT2_FS_XATTR=y
CONFIG_EXT3_FS=y
# CONFIG_EXT3_DEFAULTS_TO_ORDERED is not set
CONFIG_EXT4_FS=y
CONFIG_FUSE_FS=y
CONFIG_VFAT_FS=y
CONFIG_TMPFS=y
CONFIG_YAFFS_FS=y
CONFIG_YAFFS_DISABLE_TAGS_ECC=y
CONFIG_NLS_CODEPAGE_437=y
CONFIG_NLS_ASCII=y
CONFIG_NLS_ISO8859_1=y
CONFIG_PRINTK_TIME=y
CONFIG_MAGIC_SYSRQ=y
CONFIG_DEBUG_SHIRQ=y
# CONFIG_SCHED_DEBUG is not set
CONFIG_TIMER_STATS=y
# 20130122-JordanChen , disable some debugging options for performance improvement
# CONFIG_LOCKUP_DETECTOR=y
# CONFIG_DEBUG_ATOMIC_SLEEP=y
# CONFIG_DEBUG_STACK_USAGE=y
# CONFIG_DEBUG_LIST=y
# CONFIG_DEBUG_PAGEALLOC=y
# CONFIG_ENABLE_DEFAULT_TRACERS=y
CONFIG_DEBUG_FS=y
# 20130122-JordanChen , disable some debugging options for performance improvement
CONFIG_DEBUG_INFO=y
CONFIG_DYNAMIC_DEBUG=y
CONFIG_DEBUG_USER=y
CONFIG_CRYPTO_TWOFISH=y
CONFIG_CRC_CCITT=y

## 20120723-JordanChen , Arima's additional definitions for kernel

## WIFI
CONFIG_ATH6KL=m
CONFIG_ATH6KL_SDIO=m
CONFIG_ATH6KL_DEBUG=y
# CONFIG_ATH6KL_KOBJECT is not set
# /*FelexChing 20121012 Atheros Patch*/
CONFIG_IP_MULTICAST=y
# /*FelexChing 20121012 Atheros Patch*/

## Touch panel
## <<MelChang,[Harry] Add ELAN eKTF2040 and ILITEK ILI2013t touch panel IC
# CONFIG_TOUCHSCREEN_ELAN_EKTF2040 is not set
CONFIG_TOUCHSCREEN_CYPRESS_CY8CTMA340=y
# CONFIG_TOUCHSCREEN_ILITEK_2103T is not set

## KEYPAD
## Mel, 2012/4/18, Enable Key GPIO. ++
CONFIG_KEYBOARD_GPIO=y
## Mel, 2012/4/18, Enable Key GPIO. --

## Sensors
# /*++ Huize - 20121127 Proximity sensor++*/
# CONFIG_INPUT_ISL29021 is not set
CONFIG_INPUT_EPL6803=y
# /*-- Huize - 20121127 Proximity sensor--*/
# /*++ Huize - 20121127 Accelerometer sensor --*/
# CONFIG_INPUT_LIS3DF is not set
# CONFIG_INPUT_KXTJ9 is not set
CONFIG_INPUT_BMA250=y
# CONFIG_INPUT_BMA250E is not set
# /*-- Huize - 20121127 Accelerometer sensor --*/
# /*-- Mel - 20111124 Ecompass sensor --*/
# CONFIG_SENSORS_AK8975 is not set
CONFIG_SENSORS_AK8963=y
# /*-- Mel - 20111124 Ecompass sensor --*/

## BlueTooth
## Arima BT related configurations
CONFIG_ARIMA_BT_DBG_INFO=y
## - murphy 2011.11.07

## Panel
# CONFIG_FB_MSM_MIPI_RENESAS_CMD_FWVGA_PT_PANEL is not set
## ++Tracy add penel 
CONFIG_FB_MSM_MIPI_ILI9486_CMD_WVGA_PT_PANEL=y
## --Tracy add penel 

## LED
# <<SKIES 2011/10/19, button-backlight
# CONFIG_LEDS_ARIMA_GPIO is not set
# >>SKIES 2011/10/19
# /*++ Huize - 20120329 Add for button backlight is controlled by mpp ++*/
# CONFIG_LEDS_ACM_BUTTON_BACKLIGHT is not set
# /*-- Huize - 20120329 Add for button backlight is controlled by mpp --*/
# Edisonshih add RGB led++
CONFIG_LEDS_ACM_RED=y
CONFIG_LEDS_ACM_GREEN=y
CONFIG_LEDS_ACM_BLUE=y
CONFIG_LEDS_CHIP_LM3533=y  
# Edisonshih add RGB led--

# skywu for cts 2012-5-18
#//run cts -c android.net.cts.TrafficStatsTest -m testTrafficStatsForLocalhost
CONFIG_UID_STAT=y
#skywu for cts 2012-6-5

# Camera
CONFIG_S5K5CA_V4L2_YUV=y
# CONFIG_S5K5CA_V4L2_BAYER is not set

## ++Felex add for vpn PPTP
#Add PP2P VPN and L2TP/IPsec VPN feature
CONFIG_PPP=y
CONFIG_PPP_MULTILINK=y
CONFIG_PPP_FILTER=y
CONFIG_PPP_ASYNC=y
CONFIG_PPP_SYNC_TTY=y
CONFIG_PPP_DEFLATE=y
CONFIG_PPP_BSDCOMP=y
CONFIG_PPP_MPPE=y
CONFIG_PPPOE=y
CONFIG_PPPOATM=m
CONFIG_PPPOL2TP=y
CONFIG_PPTP=y
CONFIG_PPPOLAC=y
CONFIG_PPPOPNS=y
#Arima stevenshi for ksm on 2012/08/28
CONFIG_KSM=y
CONFIG_SYSFS=y
#Arima stevenshi for ksm on 2012/08/28
CONFIG_L2TP=y
CONFIG_L2TP_DEBUGFS=y
CONFIG_L2TP_V3=y
CONFIG_L2TP_IP=y
CONFIG_L2TP_ETH=y
CONFIG_PPPOL2TP=y
CONFIG_NET_KEY=y
CONFIG_INET_AH=y
CONFIG_INET_ESP=y
CONFIG_INET_XFRM_MODE_TRANSPORT=y
CONFIG_INET_XFRM_TUNNEL=y
CONFIG_INET_XFRM_MODE_TUNNEL=y
CONFIG_INET_XFRM_MODE_BEET=y
#Add PP2P VPN and L2TP/IPsec VPN feature
## --Felex add for vpn PPTP
##Felex add for vpn PPTP 20121015
##tracy 20121220 add a define to seperate suspend and earlysuspend work ++
CONFIG_SET_EARLYSUSPEND_WORK_QUEUE=y
##tracy 20121220 add a define to seperate suspend and earlysuspend work --
#Add PP2P VPN and L2TP/IPsec VPN feature
CONFIG_PPP=y
CONFIG_PPP_MULTILINK=y
CONFIG_PPP_FILTER=y
CONFIG_PPP_ASYNC=y
CONFIG_PPP_SYNC_TTY=y
CONFIG_PPP_DEFLATE=y
CONFIG_PPP_BSDCOMP=y
CONFIG_PPP_MPPE=y
CONFIG_PPPOE=y
CONFIG_PPPOATM=m
CONFIG_PPTP=y
CONFIG_PPPOLAC=y
CONFIG_PPPOPNS=y
#Arima stevenshi for ksm on 2012/08/28
CONFIG_KSM=y
CONFIG_SYSFS=y
#Arima stevenshi for ksm on 2012/08/28
CONFIG_L2TP=y
CONFIG_L2TP_DEBUGFS=y
CONFIG_L2TP_V3=y
CONFIG_L2TP_IP=y
CONFIG_L2TP_ETH=y
CONFIG_PPPOL2TP=y
CONFIG_NET_KEY=y
CONFIG_INET_AH=y
CONFIG_INET_ESP=y
CONFIG_INET_XFRM_MODE_TRANSPORT=y
CONFIG_INET_XFRM_TUNNEL=y
CONFIG_INET_XFRM_MODE_TUNNEL=y
CONFIG_INET_XFRM_MODE_BEET=y
#Add PP2P VPN and L2TP/IPsec VPN feature
##Felex add for vpn PPTP 20121015

## S1
# << FerryWu, 2012/06/29, SoMC S1 boot integration
CONFIG_SEMC_S1=y
# >> FerryWu, 2012/06/29, SoMC S1 boot integration

# Tamsui3-kernel-BH-PMSWakelockInfo-00+[
# CONFIG_TAMSUI_DUMP_WAKELOCK is not set
# Tamsui3-kernel-BH-PMSWakelockInfo-00+]
# Add end.
# SoMC patch - Super Stamina Mode
CONFIG_SONY_SSM=y
```
